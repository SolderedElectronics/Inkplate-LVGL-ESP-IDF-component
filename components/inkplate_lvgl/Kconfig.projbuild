## components/inkplate_lvgl/Kconfig.projbuild
```kconfig
menu "Inkplate Board"

choice INKPLATE_BOARD
    prompt "Board"

    config INKPLATE_BOARD_INKPLATE2
        bool "Inkplate2"

    config INKPLATE_BOARD_INKPLATE4
        bool "Inkplate4"

    config INKPLATE_BOARD_INKPLATE5
        bool "Inkplate5"

    config INKPLATE_BOARD_INKPLATE6
        bool "Inkplate6"

    config INKPLATE_BOARD_INKPLATE6COLOR
        bool "Inkplate6 Color"

    config INKPLATE_BOARD_INKPLATE6FLICK
        bool "Inkplate6 Flick"

    config INKPLATE_BOARD_INKPLATE10
        bool "Inkplate10"

    config INKPLATE_BOARD_INKPLATE13
        bool "Inkplate13"

    config INKPLATE_BOARD_INKPLATE7
        bool "Inkplate7"

endchoice

endmenu

menu "Wi-Fi Configuration"

config WIFI_SSID
    string "WiFi SSID"
    default ""

config WIFI_PASSWORD
    string "WiFi Password"
    default ""

endmenu
```

## components/inkplate_lvgl/examples/inkplate6/advanced/rtc/rtc_timer/sdkconfig.defaults
```kconfig
CONFIG_INKPLATE_BOARD_INKPLATE6=y
CONFIG_PARTITION_TABLE_SINGLE_APP_LARGE=y
CONFIG_SPIRAM=y
CONFIG_SPIRAM_SPEED_40M=y
CONFIG_SPIRAM_BOOT_INIT=y
CONFIG_ESP_MAIN_TASK_STACK_SIZE=16384
```

## components/inkplate_lvgl/examples/inkplate6/advanced/web_wifi/http_post_request/sdkconfig.defaults
```kconfig
CONFIG_INKPLATE_BOARD_INKPLATE6=y
CONFIG_PARTITION_TABLE_SINGLE_APP_LARGE=y
CONFIG_SPIRAM=y
CONFIG_SPIRAM_SPEED_40M=y
CONFIG_SPIRAM_BOOT_INIT=y
CONFIG_ESP_MAIN_TASK_STACK_SIZE=16384
CONFIG_ESP_TLS_INSECURE=y
CONFIG_ESP_TLS_SKIP_SERVER_CERT_VERIFY=y
```

## sdkconfig.defaults
```kconfig
CONFIG_PARTITION_TABLE_CUSTOM=y
CONFIG_PARTITION_TABLE_CUSTOM_FILENAME="partitions.csv"
CONFIG_ESPTOOLPY_FLASHSIZE_4MB=y
CONFIG_ESPTOOLPY_FLASHSIZE="4MB"
CONFIG_SPIRAM=y
CONFIG_SPIRAM_SPEED_40M=y
CONFIG_SPIRAM_BOOT_INIT=y
CONFIG_ESP_MAIN_TASK_STACK_SIZE=16384
CONFIG_ESP_TLS_INSECURE=y
CONFIG_ESP_TLS_SKIP_SERVER_CERT_VERIFY=y
```
